## boards/riscv/mpfs_discokit/Kconfig.board
```kconfig
# Copyright (c) 2024 Microchip Technology Inc
# SPDX-License-Identifier: Apache-2.0

config BOARD_MPFS_DISCOKIT
	bool "Microchip PolarFire SoC Discovery kit"
	depends on SOC_POLARFIRE
	select 64BIT
	select SCHED_IPI_SUPPORTED
	select CPU_HAS_FPU_DOUBLE_PRECISION
```

## boards/riscv/mpfs_discokit/Kconfig.defconfig
```kconfig
# Copyright (c) 2024 Microchip Technology Inc
# SPDX-License-Identifier: Apache-2.0

config BOARD
	default "mpfs_discokit"
	depends on BOARD_MPFS_DISCOKIT
```
